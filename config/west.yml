## config/west.yml
```yaml
manifest:
  remotes:
    - name: SplittedSpace
      url-base: https://github.com/SplittedSpace
  projects:
    - name: zmk-firmware__deprecated
      remote: SplittedSpace
      revision: main
      import: app/west.yml
  self:
    path: config
```
